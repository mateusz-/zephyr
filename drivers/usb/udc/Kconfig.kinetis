## drivers/usb/udc/Kconfig.kinetis
```kconfig
# Copyright (c) 2022 Nordic Semiconductor ASA
# SPDX-License-Identifier: Apache-2.0

DT_COMPAT_UDC_KINETIS := nxp,kinetis-usbd

config UDC_KINETIS
	bool "Kinetis USB device controller driver"
	imply UDC_WORKQUEUE
	default $(dt_compat_enabled,$(DT_COMPAT_UDC_KINETIS))
	help
	  Kinetis USB device controller criver.

config UDC_KINETIS_EVENT_COUNT
	int "Number or blocks in event slab"
	depends on UDC_KINETIS
	range 4 16
	help
	default 4
	  Number of blocks in slab for internal endpoint events.
```

## drivers/usb/uhc/Kconfig.max3421e
```kconfig
# Copyright (c) 2022 Nordic Semiconductor ASA
# SPDX-License-Identifier: Apache-2.0

DT_COMPAT_UHC_MAX3421E := maxim,max3421e_spi

config UHC_MAX3421E
	bool "MAX3421E driver"
	default y
	depends on $(dt_compat_enabled,$(DT_COMPAT_UHC_MAX3421E))
	select SPI
	help
	  This option enables MAX3421E USB Peripheral/Host Controller with SPI
	  Interface.

if UHC_MAX3421E

config MAX3421E_OSC_WAIT_RETRIES
	int "Maximum retries for oscillator ready event"
	default 3
	help
	  Specify the number of retries for oscillator ready event.

endif #UHC_MAX3421E
```

## drivers/usbc/vbus/Kconfig
```kconfig
# USBC VBUS Measurement configuration options

# Copyright 2022 The Chromium OS Authors
# SPDX-License-Identifier: Apache-2.0

menuconfig USBC_VBUS_DRIVER
	bool "USBC VBUS drivers"
	help
	  Enable USBC drivers

if USBC_VBUS_DRIVER

source "drivers/usbc/vbus/Kconfig.vbus_voltage_divider_adc"

endif # USBC_VBUS_DRIVER

module = USBC
module-str = usbc
source "subsys/logging/Kconfig.template.log_config"
```

## drivers/usbc/vbus/Kconfig.vbus_voltage_divider_adc
```kconfig
# VBUS device configuration options

# Copyright 2022 The Chromium OS Authors
# SPDX-License-Identifier: Apache-2.0

DT_COMPAT_VBUS_VOLTAGE_DIVIDER_ADC := vbus-voltage-divider-adc

config VBUS_VOLTAGE_DIVIDER_ADC
	bool "VBUS Voltage Divider ADC"
	default $(dt_compat_enabled,$(DT_COMPAT_VBUS_VOLTAGE_DIVIDER_ADC))
	help
	  Measure VBUS with an ADC through a voltage divider
```

## dts/bindings/usbc/usbc-port.yaml
```yaml
# Copyright 2022 The Chromium OS Authors
# SPDX-License-Identifier: Apache-2.0

description: USB-C ports

compatible: "usbc-port"

include: base.yaml

properties:
    tcpc:
        type: phandle
        required: true
        description: |
            Type-C Port Controller for this port.

    vbus:
        type: phandle
        required: true
        description: |
            VBUS measurement and control for this port.
```

## dts/bindings/usbc/vbus-voltage-divider-adc.yaml
```yaml
# Copyright 2022 The Chromium OS Authors
# SPDX-License-Identifier: Apache-2.0

description: USBC ADC Measurement and control

compatible: "vbus-voltage-divider-adc"

include: [base.yaml, voltage-divider.yaml]

properties:
    discharge-gpios:
       type: phandle-array
       required: false
```

## samples/video/capture/boards/mimxrt1050_evk.conf
```kconfig
CONFIG_VIDEO_BUFFER_POOL_SZ_MAX=261120
CONFIG_VIDEO_BUFFER_POOL_NUM_MAX=1

CONFIG_DISPLAY=y
```

## subsys/usb/device_next/class/Kconfig.cdc_acm
```kconfig
# Copyright (c) 2022 Nordic Semiconductor ASA
#
# SPDX-License-Identifier: Apache-2.0

config USBD_CDC_ACM_CLASS
	bool "USB CDC ACM implementation"
	depends on SERIAL
	depends on DT_HAS_ZEPHYR_CDC_ACM_UART_ENABLED
	select SERIAL_HAS_DRIVER
	select SERIAL_SUPPORT_INTERRUPT
	select RING_BUFFER
	select UART_INTERRUPT_DRIVEN
	help
	  USB device CDC ACM class implementation.

if USBD_CDC_ACM_CLASS

module = USBD_CDC_ACM
module-str = usbd cdc_acm
default-count = 1
source "subsys/logging/Kconfig.template.log_config"

endif
```

## subsys/usb/usbc/Kconfig
```kconfig
# USBC stack configuration options

# Copyright (c) 2022 The Chromium OS Authors
# SPDX-License-Identifier: Apache-2.0

# Workaround for not being able to have commas in macro arguments
DT_COMPAT_USBC_PORT := usbc-port

menuconfig USBC_STACK
	bool "USBC Stack Support"
	default $(dt_compat_enabled,$(DT_COMPAT_USBC_PORT))
	select SMF
	select SMF_ANCESTOR_SUPPORT
	select USBC_TCPC_DRIVER
	select USBC_VBUS_DRIVER
	help
	  Enable the USBC Stack. Note that each USBC port gets its own thread.

if USBC_STACK

config USBC_THREAD_PRIORITY
	int "USBC thread priority"
	default 0
	help
	  Set thread priority of the USBC

config USBC_STACK_SIZE
	int "USBC thread stack size"
	default 1024
	help
	  Stack size of thread created for each instance.

config USBC_STATE_MACHINE_CYCLE_TIME
	int "USBC state machine cycle time in milliseconds"
	default 5
	help
	  The USBC state machine is run in a loop and the cycle time is the
	  delay before running the loop again.

module = USBC_STACK
module-str = usbc stack
source "subsys/logging/Kconfig.template.log_config"

endif # USBC_STACK
```
